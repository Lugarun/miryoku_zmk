/*
 * Copyright (c) 2021 The ZMK Contributors
 *
 * SPDX-License-Identifier: MIT
 */

#include "rcorne.dtsi"

&default_transform {
	col-offset = <5>;
};

&kscan0 {
	row-gpios
		= <&gpio0 27  (GPIO_ACTIVE_HIGH | GPIO_PULL_DOWN)>	/* D10 */
		, <&gpio0 26  (GPIO_ACTIVE_HIGH | GPIO_PULL_DOWN)>	/* D9 */
		, <&gpio0 7   (GPIO_ACTIVE_HIGH | GPIO_PULL_DOWN)>	/* D6 */
		, <&gpio1 8   (GPIO_ACTIVE_HIGH | GPIO_PULL_DOWN)>	/* D5 */
		;
	col-gpios
		= <&gpio0 2 GPIO_ACTIVE_HIGH>		/* A4 */
		, <&gpio0 28 GPIO_ACTIVE_HIGH>		/* A3  */
		, <&gpio0 30 GPIO_ACTIVE_HIGH>		/* A2   */
		, <&gpio0 5 GPIO_ACTIVE_HIGH>		/* A1   */
		, <&gpio0 4 GPIO_ACTIVE_HIGH>		/* A0   */
		;
};
