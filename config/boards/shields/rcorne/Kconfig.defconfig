## config/boards/shields/rcorne/Kconfig.defconfig
```kconfig
# Copyright (c) 2021 The ZMK Contributors
# SPDX-License-Identifier: MIT

if SHIELD_RCORNE_LEFT

config ZMK_KEYBOARD_NAME
    default "RCORNE"

config ZMK_SPLIT_ROLE_CENTRAL
    default y

endif

if SHIELD_RCORNE_LEFT || SHIELD_RCORNE_RIGHT

config ZMK_SPLIT
    default y

endif
```

## config/boards/shields/rcorne/Kconfig.shield
```kconfig
# Copyright (c) 2021 The ZMK Contributors
# SPDX-License-Identifier: MIT

config SHIELD_RCORNE_LEFT
	def_bool $(shields_list_contains,rcorne_left)

config SHIELD_RCORNE_RIGHT
	def_bool $(shields_list_contains,rcorne_right)
```
